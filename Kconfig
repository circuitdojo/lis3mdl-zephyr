## Kconfig
```kconfig
#
# Copyright (c) 2021 Circuit Dojo LLC
#

rsource "driver/sensors/lis3mdl/Kconfig"
```

## dts/bindings/st,lis3mdl.yaml
```yaml
# Copyright (c) 2017, Linaro Limited
# SPDX-License-Identifier: Apache-2.0

description: STMicroelectronics LIS3MDL magnetometer

compatible: "st,lis3mdl"

include: i2c-device.yaml

properties:
    drdy-gpios:
      required: false
      type: phandle-array
      description: DRDY pin

        This pin defaults to active high when produced by the sensor.
        The property value should ensure the flags properly describe
        the signal that is presented to the driver.
    irq-gpios:
      required: false
      type: phandle-array
      description: INT pin
```
